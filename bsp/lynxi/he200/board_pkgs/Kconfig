## bsp/lynxi/hp232x/drivers/Kconfig
```kconfig
config BSP_SUPPORT_FPU
    bool "Using Float"
    default n

menu "Hardware Drivers Config"
    menu "BCM Peripheral Drivers"
        menuconfig BSP_USING_UART
            bool "Using UART"
            select RT_USING_SERIAL
            default y

            if BSP_USING_UART
                config RT_USING_UART0
                bool "Enable UART 0"
                default y

                config RT_USING_UART1
                bool "Enable UART 1"
                default n
            endif

        menuconfig BSP_USING_GIC
            bool "Enable GIC"
            select RT_USING_GIC
            default y

            if BSP_USING_GIC
                choice
                    prompt "GIC Version"
                    default BSP_USING_GICV3

                    config BSP_USING_GICV2
                        bool "Enable GIC400(GICV2)"

                    config BSP_USING_GICV3
                        bool "Enable GIC500(GICV3)"
                endchoice

                config RT_BSP_GIC_DBG
                    bool "Enable GIC group config debug"
                    default n
                    help
                        Enable GIC interrupt group configuration debug code.
                        Useful for debugging GIC secure/non-secure routing.
                        Disable to reduce code size.
            endif

        config KERNEL_ASPACE_START
            hex "Kernel aspace start address"
            default 0x04000000

        config BSP_USING_PIN
            bool "Using PIN"
            select RT_USING_PIN
            default n

        config BSP_USING_SYSCTL_CLK
            bool "Lynxi Lite sysctl clock gates (CPR@0x12500000)"
            default y
            help
                Open fabric/UART timer-related clock gates before arch timer
                bring-up. Aligns with he200 lynxi_sysctl_lite_init().

        config BSP_USING_HP232X_ARCH_TIMER_PROBE
            bool "Print CNTPCT frequency before/after sysctl"
            depends on BSP_USING_SYSCTL_CLK
            default y
            help
                Measure CNTPCT delta over one reported second at board init.
                For arch timer debug only; disable in release builds.

        config BSP_USING_CORETIMER
            bool "Using ARM generic core timer"
            select RT_USING_CORETIMER
            depends on !BSP_USING_APB_TIMER_AS_TICK
            default y

        menuconfig BSP_USING_APB_TIMER
            bool "Enable DesignWare APB system timer"
            default y

        if BSP_USING_APB_TIMER
            config BSP_USING_APB_TIMER_AS_TICK
                bool "Use DesignWare APB timer as system tick"
                default y
                help
                    Use DW APB timer@0x10012000 as the RT-Thread OS tick source.
                    When enabled, the ARM generic timer is not initialized as the
                    system tick source.

            config HP232X_APB_TIMER_CLOCK
                int "DesignWare APB timer clock frequency"
                default 50000000

            config HP232X_APB_TIMER_TICK_ID
                int "DesignWare APB timer channel for system tick"
                range 0 3
                default 0
        endif

        config BSP_DRV_PVT_BOOT_SAMPLE
            bool "Print PVT TS/VM at boot init"
            default n
            help
                Enable boot-time PVT channel dump in drv_subsys_init.
                Heartbeat still reads PVT via drv_emmc_biz when disabled.

        config BSP_HP232X_MM_MINIMAL
            bool "Minimal MM component (drop anon/fault, MM shell cmds)"
            default y
            help
                Remove mm_anon.c and mm_fault.c; stub private-map APIs.
                hp232x uses custom hp232x_mmu identity map — COW/fork unused.
                Also drops list_kmem/list_page finsh commands to save IRAM0.

        config BSP_BIZ_SKIP_THREADS
            bool "Skip biz worker threads (flash/finsh debug)"
            default n
            help
                Do not start i2c_mcu, mcu_err, or emmc_biz threads.
                Keeps biz_init (flash/emmc object init) and FinSH msh.
                Use for SPI flash read/write testing without emmc_biz
                flooding the console or starving the shell.

        config BSP_BIZ_EMMC_ON_CPU1
            bool "Bind emmc_biz thread to CPU1 (SMP)"
            depends on RT_USING_SMP
            default y
            help
                Create emmc_biz on CPU0 but bind it to CPU1 before startup.
                Requires CPU1 online (main waits for idle ready).

        menu "Driver business modules (hp640 SPL port)"
            comment "Disable all but one module for incremental bring-up / debug."

            config BSP_DRV_MOD_EXEC_APU
                bool "Exec: DgbRead, APUDebug, PWM, ApuClock"
                default y

            config BSP_DRV_MOD_EXEC_MISC
                bool "Exec: CRC32, Timer, SetTimestamp"
                default y

            config BSP_DRV_MOD_EXEC_STRESS
                bool "Exec: eMMC Stress"
                default y

            config BSP_DRV_MOD_EXEC_SELFTEST
                bool "Exec: SelfTest + eMMC report"
                default y

            config BSP_DRV_MOD_EMMC_DLL
                bool "eMMC DLL scan + flash store"
                default y

            config BSP_DRV_MOD_PCIE
                bool "PCIe init / setup / stress"
                default y

            config BSP_DRV_MOD_FLASH_UPGRADE
                bool "FlashWrite CRC verify + upgrade helpers"
                default y

            config BSP_DRV_MOD_FINSH
                bool "Finsh MSH module test commands"
                default n
                help
                    Register hp640-style debug commands (stress, pcie, self_test…).
                    Enable one module at a time together with matching BSP_DRV_MOD_*.
        endmenu

        config RT_BSP_PMON_TEST
            bool "Enable PMON GIC monitor thread"
            default y
            help
                Enable the PMON (Periodic MONitor) thread that prints GIC
                status and system tick information every 2.5 seconds.
                Useful for verifying system tick and interrupt functionality.
                Disable to reduce code size and IRAM usage.

        config BSP_USING_HP232X_PMON_BIND_CPU1
            bool "Run PMON thread bound to CPU1 (SMP test)"
            depends on RT_BSP_PMON_TEST && RT_USING_SMP
            default n
            help
                Bind the PMON monitor thread to CPU1 and print rt_hw_cpu_id()
                on each sample. Verifies IPI-driven scheduling on the secondary
                core while system tick stays on CPU0 APB timer.

        config BSP_USING_HP232X_SMP_BIND_TEST
            bool "Enable SMP CPU1 bind self-test at boot"
            depends on RT_USING_SMP
            default n
            help
                Create a worker thread bound to CPU1 during main() and verify
                that it runs. For bring-up/debug only; disable in release builds.
    endmenu
endmenu
```

## libcpu/aarch64/Kconfig
```kconfig
menu "AArch64 Architecture Configuration"
    config ARCH_TEXT_OFFSET
        hex "Text offset"
        default 0x200000
    config ARCH_RAM_OFFSET
        hex "RAM offset"
        default 0
    config ARCH_SECONDARY_CPU_STACK_SIZE
        int "Secondary CPU stack size"
        default 4096
    config ARCH_HAVE_EFFICIENT_UNALIGNED_ACCESS
        bool
        default y
    config ARCH_USING_GENERIC_CPUID
        bool "Using generic cpuid implemenation"
        select ARCH_USING_HW_THREAD_SELF
        default y if RT_USING_OFW
        default n
    config ARCH_HEAP_SIZE
        hex "Size of system heap"
        default 0x4000000
    config ARCH_INIT_PAGE_SIZE
        hex "Size of init page region"
        default 0x200000

    config RT_KERNEL_IRQ_DBG
        bool "Enable verbose AArch64 IRQ/exception debug tracing"
        default n
        help
            Enable early UART tracing in AArch64 IRQ, exception, and IRQ
            context-switch paths. This is intended for low-level bring-up and
            fault localization only. Leave it disabled for normal builds because
            it is very verbose and changes IRQ timing.
endmenu
```
