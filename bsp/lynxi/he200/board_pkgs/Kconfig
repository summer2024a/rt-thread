## bsp/lynxi/he200/board_pkgs/Kconfig
```kconfig
menu "Board local packages (lwext4, rpmsg-lite)"

config BOARD_PKG_USING_LWEXT4
    bool "lwext4 filesystem (board_pkgs/lwext4)"
    default y
    select RT_USING_DFS
    select RT_USING_DFS_LWEXT4

config BOARD_PKG_USING_LWEXT4_LATEST_VERSION
    bool
    default y
    depends on BOARD_PKG_USING_LWEXT4

config BOARD_PKG_USING_RPMSG_LITE
    bool "RPMsg-Lite (board_pkgs/rpmsg-lite)"
    default y

config BOARD_PKG_USING_RPMSG_LITE_LATEST_VERSION
    bool
    default y
    depends on BOARD_PKG_USING_RPMSG_LITE

endmenu
```

## bsp/lynxi/he200/defconfig
```kconfig
CONFIG_RT_KLIBC_USING_LIBC_STRNCPY=y
CONFIG_RT_NAME_MAX=24
CONFIG_RT_USING_SMP=y
CONFIG_RT_CPUS_NR=8
CONFIG_RT_TICK_PER_SECOND=100
CONFIG_IDLE_THREAD_STACK_SIZE=8192
CONFIG_RT_TIMER_THREAD_STACK_SIZE=8192
# CONFIG_RT_USING_MEMPOOL is not set
CONFIG_RT_USING_MEMHEAP=y
CONFIG_RT_USING_SLAB_AS_HEAP=y
CONFIG_RT_USING_MEMTRACE=y
CONFIG_RT_USING_INTERRUPT_INFO=y
CONFIG_RT_CONSOLE_DEVICE_NAME="uart0"
CONFIG_RT_USING_STDC_ATOMIC=y
CONFIG_ARCH_TEXT_OFFSET=0x100000
CONFIG_ARCH_RAM_OFFSET=0x800000000
CONFIG_RT_MAIN_THREAD_STACK_SIZE=8192
CONFIG_FINSH_THREAD_STACK_SIZE=8192
CONFIG_DFS_FD_MAX=32
CONFIG_RT_USING_DFS_V2=y
CONFIG_RT_USING_DFS_ELMFAT=y
CONFIG_RT_USING_DFS_TMPFS=y
CONFIG_RT_USING_DEV_BUS=y
CONFIG_RT_USING_SYSTEM_WORKQUEUE=y
CONFIG_RT_SYSTEM_WORKQUEUE_STACKSIZE=8192
CONFIG_RT_USING_NULL=y
CONFIG_RT_USING_ZERO=y
CONFIG_RT_USING_RANDOM=y
# CONFIG_RT_USING_PIN is not set
CONFIG_RT_USING_POSIX_FS=y
CONFIG_RT_USING_POSIX_POLL=y
CONFIG_RT_USING_POSIX_TERMIOS=y
CONFIG_RT_USING_POSIX_CLOCK=y
CONFIG_RT_USING_POSIX_TIMER=y
CONFIG_RT_USING_UTEST=y
CONFIG_UTEST_THR_STACK_SIZE=8192
CONFIG_BSP_SUPPORT_FPU=y
CONFIG_BSP_SDIO0_EMMC=y
CONFIG_BSP_SDIO0_1V8=y
# CONFIG_BSP_USING_PIN is not set
CONFIG_RT_MMCSD_DBG=y
CONFIG_KERNEL_ASPACE_START=0x1000000
```

## bsp/lynxi/he200/drivers/Kconfig
```kconfig
config BSP_SUPPORT_FPU
    bool "Using Float"
    default n

menuconfig BSP_USING_VM_MODE
    bool "Enable VM mode"
    default n

menu "Hardware Drivers Config"
    menu "BCM Peripheral Drivers"
        menuconfig BSP_USING_UART
            bool "Using UART"
            select RT_USING_SERIAL
            default y

            if BSP_USING_UART
                config RT_USING_UART0
                bool "Enable UART 0"
                default y

                config RT_USING_UART1
                bool "Enable UART 1"
                default n
            endif

        menuconfig BSP_USING_SDIO
            bool "Enable SDIO"
            select RT_USING_SDIO
            default y

            if BSP_USING_SDIO

                choice BSP_SDIO_DEV
                    prompt "Select SDIO device"
                    default BSP_USING_SDIO0
                    help
                        Select the SDIO device to be used.

                    config BSP_USING_SDIO0
                        bool "Enable SDIO0"

                        if BSP_USING_SDIO0
                            config BSP_SDIO0_EMMC
                            bool "Enable eMMC"
                            default n

                            config BSP_SDIO0_1V8
                            bool "Enable 1.8V"
                            default n
                        endif

                    config BSP_USING_SDIO1
                        bool "Enable SDIO1"
                endchoice

                config BSP_SD_MNT_DEVNAME
                    string "The name of the SD-BlkDev to be mounted"
                    default "sd0p1"

                config RT_MMCSD_DBG
                    bool "Enable SDIO debug"
                    default n
            endif

        menuconfig BSP_USING_GIC
            bool "Enable GIC"
            select RT_USING_GIC
            default y

            if BSP_USING_GIC
                choice
                    prompt "GIC Version"
                    default BSP_USING_GICV3

                    config BSP_USING_GICV2
                        bool "Enable GIC400(GICV2)"

                    config BSP_USING_GICV3
                        bool "Enable GIC500(GICV3)"
                endchoice
            endif

        config KERNEL_ASPACE_START
            hex "Kernel aspace start address"
            default 0x0

        config BSP_USING_PIN
            bool "Using PIN"
            select RT_USING_PIN
            default y

        config BSP_USING_SYSCTL_CLK
            bool "Lynxi Lite sysctl clock gates (Linux clk-lynxi-lite.c)"
            default y
            help
              Enable gate bits on sysctl@12500000 to match Linux drivers/clk/lynxi/clk-lynxi-lite.c
              (DMA/UART/I2C/GMAC/...). Recommended for HE200/EVB when Linux-style CPR is expected.

        menuconfig BSP_USING_RESET
            bool "Enable reset controller"
            default y

            if BSP_USING_RESET
                config BSP_USING_RESET_CTRL
                    bool
                    default y
            endif

        menuconfig BSP_USING_I2C
            bool "Enable DesignWare I2C (dw-apb-i2c)"
            select RT_USING_I2C
            depends on BSP_USING_RESET
            default n

            if BSP_USING_I2C
                config BSP_USING_I2C0
                    bool "Enable I2C0"
                    default y

                config BSP_USING_I2C1
                    bool "Enable I2C1"
                    default y

                config BSP_USING_I2C2
                    bool "Enable I2C2"
                    default n

                config BSP_USING_I2C3
                    bool "Enable I2C3"
                    default n
            endif

        menuconfig BSP_USING_PCIE
            bool "Enable PCIE"
            default n

            if BSP_USING_PCIE
                choice
                    prompt "PCIE MODE"
                    default BSP_USING_PCIE_EP

                    config BSP_USING_PCIE_EP
                        bool "PCIE EP"

                    config BSP_USING_PCIE_RC
                        bool "PCIE RC"
                endchoice
            endif

        config BSP_USING_CORETIMER
            bool "Using core timer"
            select RT_USING_CORETIMER
            default y

        menuconfig BSP_USING_SYSTIMER
            bool "Enable SYSTIMER"
            default n

        if  BSP_USING_SYSTIMER
            config RT_USING_SYSTIMER1
                bool "Enable sys timer1"
                default n
            config RT_USING_SYSTIMER3
                bool "Enable sys timer3"
                default n
        endif

        config BSP_USING_GMAC
            bool "Enable Synopsys GMAC driver"
            depends on RT_USING_LWIP
            depends on BSP_USING_PIN
            depends on !BSP_USING_RPMSG_NET
            default n
            help
                与 BSP_USING_RPMSG_NET 互斥（双网卡争用 lwIP/中断资源）。

        config RT_USING_GMAC_INT_MODE
            bool "Use GMAC interrupt mode"
            depends on BSP_USING_GMAC
            default y

        config BSP_GMAC_INIT_PINMUX
            bool "GMAC rt_hw_eth_init: pinmux pins 21-30 and 35 (RGMII/PHY)"
            depends on BSP_USING_GMAC
            default y
            help
                若与 SDIO/eMMC 引脚复用冲突导致存储异常，可关闭此项以验证（引脚应由 Boot/板级另行配置）。

        config BSP_USING_RTC
            bool "Enable DW RTC"
            select RT_USING_RTC
            depends on BSP_USING_RESET
            default n

        config BSP_USING_EFUSE
            bool "Enable eFuse readout"
            default n

        config BSP_USING_DW_AXI_DMA
            bool "Enable DW AXI DMA helper"
            depends on BSP_USING_RESET
            default n

        if BOARD_PKG_USING_RPMSG_LITE
            config BSP_USING_RPMSG_NET
                bool "Using RPMSG-NET"
                depends on !BSP_USING_GMAC
                select RT_USING_LWIP
                select RT_USING_MUTEX
                default n
                help
                    与 BSP_USING_GMAC 互斥；调试板载 GMAC 时请关闭本项。

            if BSP_USING_RPMSG_NET
                comment "GMAC+e0: set RT_LWIP_IPADDR to e0 subnet (e.g. 192.168.1.x); rpnet0 uses BSP_RPMSG_NET_* in rtconfig.h"

                config BSP_USING_RPSH
                    bool "Enable RPSH remote shell server"
                    default n
                    help
                        Remote MSH over rpmsg-net (EtherType 0x88B6). Depends on rpmsg-net.

                config BSP_RPMSG_NET_BIND_CPU0
                    bool "Pin rpmsg-net stack to one CPU (SMP)"
                    depends on RT_USING_SMP
                    default y
                    help
                        Binds tcpip, erx, etx, rpnet_rx, rpmsg_wait, sh_srv to BSP_RPMSG_NET_CPU.
                        Rpmsg-lite DW timer IRQ affinity is configured separately below (same CPU by default).

                config BSP_RPMSG_NET_CPU
                    int "Target CPU index for rpmsg-net / RPSH / lwIP workers"
                    depends on BSP_RPMSG_NET_BIND_CPU0
                    range 0 15
                    default 0

                config BSP_RPMSG_NET_IRQ_FOLLOW_WORKER_CPU
                    bool "Rpmsg timer IRQs use same CPU as workers"
                    depends on BSP_RPMSG_NET_BIND_CPU0
                    default y
                    help
                        When set, GIC affinity for rpmsg_platform DW timer IRQs (TIMER_IRQ_START+2,+3)
                        matches BSP_RPMSG_NET_CPU. Clear to set BSP_RPMSG_NET_IRQ_CPU instead.

                config BSP_RPMSG_NET_IRQ_CPU
                    int "Dedicated CPU for rpmsg-lite DW timer IRQs (GIC)"
                    depends on BSP_RPMSG_NET_BIND_CPU0 && !BSP_RPMSG_NET_IRQ_FOLLOW_WORKER_CPU
                    range 0 15
                    default 0
            endif
        endif
    endmenu
endmenu
```

## bsp/lynxi/hp232x/defconfig
```kconfig
CONFIG_RT_KLIBC_USING_LIBC_STRNCPY=y
CONFIG_RT_NAME_MAX=24
CONFIG_RT_USING_SMP=y
CONFIG_RT_CPUS_NR=2
CONFIG_RT_TICK_PER_SECOND=100
CONFIG_IDLE_THREAD_STACK_SIZE=4096
CONFIG_RT_TIMER_THREAD_STACK_SIZE=4096
CONFIG_RT_USING_MEMHEAP=y
CONFIG_RT_USING_SLAB_AS_HEAP=y
CONFIG_RT_USING_MEMTRACE=y
CONFIG_RT_USING_INTERRUPT_INFO=y
CONFIG_RT_CONSOLE_DEVICE_NAME="uart0"
CONFIG_RT_USING_STDC_ATOMIC=y
CONFIG_ARCH_TEXT_OFFSET=0x0
CONFIG_ARCH_RAM_OFFSET=0x04000000
CONFIG_RT_MAIN_THREAD_STACK_SIZE=4096
CONFIG_FINSH_THREAD_STACK_SIZE=4096
CONFIG_BSP_USING_UART=y
CONFIG_RT_USING_UART0=y
CONFIG_BSP_USING_GIC=y
CONFIG_BSP_USING_GICV3=y
CONFIG_KERNEL_ASPACE_START=0x04000000
CONFIG_BSP_USING_CORETIMER=y
```
